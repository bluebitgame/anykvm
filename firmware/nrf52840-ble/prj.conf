## CMakeLists.txt
```
cmake_minimum_required(VERSION 3.20.0)

# AnyKVM nRF52840 BLE HID firmware (Zephyr / nRF Connect SDK).
find_package(Zephyr REQUIRED HINTS $ENV{ZEPHYR_BASE})
project(anykvm_ble_hid)

# Keep checkout paths out of firmware assertion strings.
# Derive the prefix in CMake so it also matches paths reached through symlinks.
get_filename_component(ANYKVM_SOURCE_ROOT "${CMAKE_CURRENT_SOURCE_DIR}/../.." ABSOLUTE)
zephyr_compile_options("-ffile-prefix-map=${ANYKVM_SOURCE_ROOT}=.")

target_sources(app PRIVATE
    src/main.c
    src/hids.c
    src/profiles.c
    src/proto.c
    src/reply.c
    src/led.c
)

target_include_directories(app PRIVATE src)
```

## Kconfig
```
# AnyKVM application-specific Kconfig options.
# Sourced automatically by the Zephyr build for this application.

menu "AnyKVM BLE HID"

config APP_PROFILE_COUNT
	int "Number of switchable device profiles (BLE identities/bond slots)"
	default 4
	range 1 4
	help
	  Each profile is an independent BLE identity with its own bond, so
	  different hosts (iPhone, iPad, ...) can each pair once and be switched
	  between with the 0x20 serial command. Must be <= BT_ID_MAX and
	  BT_MAX_PAIRED.

endmenu

source "Kconfig.zephyr"
```

## prj.conf
```kconfig
# AnyKVM nRF52840 BLE HID firmware configuration.

# --- NCS sample defaults (enables ASSERT, LOG, HW_STACK_PROTECTION) ---
CONFIG_NCS_SAMPLES_DEFAULTS=y

# --- Bluetooth peripheral + HID over GATT (HoGP) ---
CONFIG_BT=y
CONFIG_BT_PERIPHERAL=y
CONFIG_BT_DEVICE_NAME="AnyKVM"
CONFIG_BT_DEVICE_APPEARANCE=961
CONFIG_BT_HIDS=y
CONFIG_BT_HIDS_MAX_CLIENT_COUNT=1
CONFIG_BT_HIDS_ATTR_MAX=30
# keyboard + mouse input reports (only one active report map at a time)
CONFIG_BT_HIDS_INPUT_REP_MAX=2
# iOS disconnects or ignores HID input without encrypted GATT attributes.
# CONFIG_BT_HIDS_DEFAULT_PERM_RW is not set
CONFIG_BT_HIDS_DEFAULT_PERM_RW_ENCRYPT=y
CONFIG_BT_GATT_DYNAMIC_DB=y
CONFIG_BT_CONN_CTX=y
CONFIG_BT_L2CAP_TX_BUF_COUNT=5
CONFIG_BT_GATT_UUID16_POOL_SIZE=40
CONFIG_BT_GATT_CHRC_POOL_SIZE=20

# --- Bonding / security (iOS requires bonding for HID) ---
CONFIG_BT_SMP=y
# Headless dongle: allow Just Works pairing (no passkey UI on device).
CONFIG_BT_SMP_ENFORCE_MITM=n
CONFIG_BT_SETTINGS=y
CONFIG_SETTINGS=y
CONFIG_SETTINGS_RUNTIME=y
CONFIG_FLASH=y
CONFIG_FLASH_MAP=y
CONFIG_NVS=y
CONFIG_FLASH_PAGE_LAYOUT=y

# Multi-device: one BLE identity + bond slot per profile (see profiles.c).
# APP_PROFILE_COUNT identities are created at boot; keep MAX_PAIRED >= count.
CONFIG_BT_MAX_PAIRED=4
CONFIG_BT_MAX_CONN=1
CONFIG_BT_ID_MAX=4

# Low-latency HID: 7.5 ms connection interval (units of 1.25 ms).
# Default Zephyr pref is 24–40 (30–50 ms), which dominates mouse lag.
CONFIG_BT_PERIPHERAL_PREF_MIN_INT=6
CONFIG_BT_PERIPHERAL_PREF_MAX_INT=6
CONFIG_BT_PERIPHERAL_PREF_LATENCY=0
CONFIG_BT_PERIPHERAL_PREF_TIMEOUT=400
CONFIG_BT_GAP_PERIPHERAL_PREF_PARAMS=y

# --- USB CDC ACM serial (command channel from AnyKVM host) ---
CONFIG_USB_DEVICE_STACK=y
CONFIG_USB_CDC_ACM=y
CONFIG_USB_DEVICE_VID=0x1209
CONFIG_USB_DEVICE_PID=0x0001
CONFIG_USB_DEVICE_PRODUCT="AnyKVM BLE HID"
CONFIG_UART_LINE_CTRL=y
CONFIG_UART_INTERRUPT_DRIVEN=y
CONFIG_SERIAL=y

# --- App tunables (see Kconfig) ---
CONFIG_APP_PROFILE_COUNT=4

# --- GPIO (LED status indicator) ---
CONFIG_GPIO=y

# --- System ---
CONFIG_MAIN_STACK_SIZE=2048
CONFIG_HEAP_MEM_POOL_SIZE=2048
CONFIG_SYSTEM_WORKQUEUE_STACK_SIZE=2048
# CDC ACM carries AnyKVM binary frames only — no printk/log on this UART.
CONFIG_CONSOLE=n
CONFIG_UART_CONSOLE=n
CONFIG_LOG=n
CONFIG_USE_SEGGER_RTT=n
```

## boards/adafruit_feather_nrf52840.overlay
```dts
&zephyr_udc0 {
    cdc_acm_uart: cdc-acm-uart {
        compatible = "zephyr,cdc-acm-uart";
    };
};
```

## src/main.c
```c
/*
 * AnyKVM nRF52840 firmware - main: USB CDC + AnyKVM framed protocol.
 */
#include <zephyr/kernel.h>
#include <zephyr/logging/log.h>
#include <zephyr/device.h>
#include <zephyr/drivers/uart.h>
#include <zephyr/usb/usb_device.h>
#include <zephyr/bluetooth/bluetooth.h>

#include "hids.h"
#include "profiles.h"
#include "proto.h"
#include "reply.h"
#include "led.h"
#include "../../AnyKVMProtocol/src/AnyKVMDevice.h"

LOG_MODULE_REGISTER(anykvm_main, LOG_LEVEL_INF);

static bk_device control;
static void control_reply(void *ctx, uint8_t cmd, const uint8_t *data) {
    ARG_UNUSED(ctx); reply_send(cmd, data);
}
static uint8_t control_status(void *ctx) {
    ARG_UNUSED(ctx);
    struct profile_status st;
    anykvm_profiles_status(&st);
    led_set(st.connected, st.advertising, st.bonded);
    return (st.slot & 3) | (st.connected ? 4 : 0) |
           (st.bonded ? 8 : 0) | (st.advertising ? 16 : 0);
}
static void control_keyboard(void *ctx, const uint8_t *report) {
    ARG_UNUSED(ctx); anykvm_hids_send_keyboard(report);
}
static void control_mouse(void *ctx, bool absolute, const uint8_t *r, size_t size) {
    ARG_UNUSED(ctx); ARG_UNUSED(size);
    if (absolute)
        anykvm_hids_send_mouse(r[0], (uint16_t)r[1] | (uint16_t)r[2] << 8,
                               (uint16_t)r[3] | (uint16_t)r[4] << 8, (int8_t)r[5]);
    else anykvm_hids_send_mouse(r[0], (int8_t)r[1], (int8_t)r[2], (int8_t)r[3]);
}
static uint8_t control_mode(void *ctx, bool absolute) {
    ARG_UNUSED(ctx);
    return anykvm_profiles_set_mouse_mode(absolute) ? BK_INTERNAL : BK_OK;
}
static uint8_t control_profile(void *ctx, uint8_t cmd, uint8_t slot) {
    ARG_UNUSED(ctx);
    int result = cmd == 0x20 ? anykvm_profiles_select(slot) :
                 cmd == 0x21 ? anykvm_profiles_clear(slot) : anykvm_profiles_advertise();
    control.input.absolute = anykvm_profiles_mouse_mode();
    return result ? BK_INTERNAL : BK_OK;
}
static void control_init(void) {
    control.capabilities = BK_KEYBOARD | BK_RELATIVE | BK_ABSOLUTE | BK_BLE | BK_PROFILES;
    control.slots = CONFIG_APP_PROFILE_COUNT; control.model = BK_MODEL_NRF52840;
    control.reply = control_reply; control.status = control_status;
    control.mode = control_mode; control.profile = control_profile;
    control.input.absolute = anykvm_profiles_mouse_mode();
    control.input.keyboard = control_keyboard; control.input.mouse = control_mouse;
}
static void frame_handler(uint8_t cmd, const uint8_t data[4]) {
    bk_command(&control, cmd, data);
}

/* --- USB CDC RX ------------------------------------------------------- */

static const struct device *cdc_dev;

static void host_dtr_poll(void);

K_MSGQ_DEFINE(rx_msgq, 1, 256, 4);

static void cdc_irq_handler(const struct device *dev, void *user_data)
{
	ARG_UNUSED(user_data);

	while (uart_irq_update(dev) && uart_irq_is_pending(dev)) {
		if (!uart_irq_rx_ready(dev)) {
			break;
		}
		uint8_t byte;

		while (uart_fifo_read(dev, &byte, 1) == 1) {
			k_msgq_put(&rx_msgq, &byte, K_NO_WAIT);
		}
	}
}

static int cdc_init(void)
{
	int err;

	if (IS_ENABLED(CONFIG_USB_DEVICE_STACK)) {
		err = usb_enable(NULL);
		if (err && err != -EALREADY) {
			LOG_ERR("usb_enable: %d", err);
			return err;
		}
	}

	cdc_dev = DEVICE_DT_GET_ONE(zephyr_cdc_acm_uart);
	if (!device_is_ready(cdc_dev)) {
		LOG_ERR("CDC UART not ready");
		return -ENODEV;
	}

	reply_set_device(cdc_dev);

	if (IS_ENABLED(CONFIG_UART_LINE_CTRL)) {
		for (int i = 0; i < 50; i++) {
			uint32_t dtr = 0;

			uart_line_ctrl_get(cdc_dev, UART_LINE_CTRL_DTR, &dtr);
			if (dtr) {
				break;
			}
			k_msleep(20);
		}
		(void)uart_line_ctrl_set(cdc_dev, UART_LINE_CTRL_DCD, 1);
		(void)uart_line_ctrl_set(cdc_dev, UART_LINE_CTRL_DSR, 1);
	}

	err = uart_irq_callback_user_data_set(cdc_dev, cdc_irq_handler, NULL);
	if (err) {
		LOG_ERR("uart irq callback: %d", err);
		return err;
	}

	uart_irq_rx_enable(cdc_dev);
	host_dtr_poll();
	return 0;
}

static void host_dtr_poll(void)
{
	if (!IS_ENABLED(CONFIG_UART_LINE_CTRL) || cdc_dev == NULL) {
		return;
	}

	uint32_t dtr = 0;

	if (uart_line_ctrl_get(cdc_dev, UART_LINE_CTRL_DTR, &dtr) != 0) {
		return;
	}
	led_set_pc_host(dtr != 0);
}

static void fatal_blink(void)
{
	while (1) {
		led_on();
		k_msleep(100);
		led_off();
		k_msleep(100);
	}
}

/* --- main ------------------------------------------------------------- */

int main(void)
{
	int err;
	uint8_t byte;

	led_init();

	err = cdc_init();
	if (err) {
		fatal_blink();
	}

	err = anykvm_profiles_init();
	if (err) {
		LOG_ERR("profiles init: %d", err);
		fatal_blink();
	}

	err = anykvm_hids_init(false);
	if (err) {
		LOG_ERR("hids init: %d", err);
		fatal_blink();
	}

	err = bt_enable(NULL);
	if (err) {
		LOG_ERR("bt_enable: %d", err);
		fatal_blink();
	}

	err = anykvm_profiles_start(false);
	if (err) {
		LOG_ERR("profiles start: %d", err);
		fatal_blink();
	}

	control_init();
	bool was_connected = false;
	proto_reset();
	LOG_INF("AnyKVM nRF52840 ready");

	while (1) {
        host_dtr_poll();
        bool connected = (control_status(NULL) & 4) != 0;
        if (was_connected != connected) bk_reset(&control.input);
        was_connected = connected;

		/* Drain pending USB CDC commands through the shared protocol. */
		if (k_msgq_get(&rx_msgq, &byte, K_MSEC(100)) == 0) {
			do {
				proto_rx_byte(byte, frame_handler);
			} while (k_msgq_get(&rx_msgq, &byte, K_NO_WAIT) == 0);

		}
	}
}
```

## src/hids.c
```c
/*
 * AnyKVM nRF52840 firmware — BLE HID service implementation.
 *
 * Two mouse report maps are available; only one is active at a time
 * (report ID 2 in both modes).  Keyboard (report ID 1) is unchanged.
 *
 * Dynamic mode switching: call anykvm_hids_deinit(), then
 * anykvm_hids_init(new_abs_mode).  This rebuilds the GATT HID service.
 * Requires CONFIG_BT_GATT_DYNAMIC_DB=y and bt_hids_uninit()
 * (nRF Connect SDK v2.5+).  See anykvm_hids_deinit() comments.
 */
#include <zephyr/kernel.h>
#include <zephyr/logging/log.h>
#include <zephyr/bluetooth/bluetooth.h>
#include <zephyr/bluetooth/conn.h>
#include <bluetooth/services/hids.h>

#include "hids.h"

LOG_MODULE_REGISTER(anykvm_hids, LOG_LEVEL_INF);

#define REPORT_ID_KEYBOARD 1
#define REPORT_ID_MOUSE    2

#define KEYBOARD_REPORT_LEN  8
#define MOUSE_REL_REPORT_LEN 4
#define MOUSE_ABS_REPORT_LEN 6

#define INPUT_REP_IDX_KEYBOARD 0
#define INPUT_REP_IDX_MOUSE    1

static const uint8_t report_map_rel[] = {
	/* --- Keyboard, report ID 1 --- */
	0x05, 0x01,       /* Usage Page (Generic Desktop) */
	0x09, 0x06,       /* Usage (Keyboard) */
	0xA1, 0x01,       /* Collection (Application) */
	0x85, REPORT_ID_KEYBOARD,
	0x05, 0x07,       /*   Usage Page (Key Codes) */
	0x19, 0xE0,       /*   Usage Min (224: LeftControl) */
	0x29, 0xE7,       /*   Usage Max (231: Right GUI) */
	0x15, 0x00,       /*   Logical Min (0) */
	0x25, 0x01,       /*   Logical Max (1) */
	0x75, 0x01,       /*   Report Size (1) */
	0x95, 0x08,       /*   Report Count (8) */
	0x81, 0x02,       /*   Input (Data, Var, Abs): modifier bits */
	0x75, 0x08,       /*   Report Size (8) */
	0x95, 0x01,       /*   Report Count (1) */
	0x81, 0x01,       /*   Input (Const): reserved byte */
	0x05, 0x07,       /*   Usage Page (Key Codes) */
	0x19, 0x00,       /*   Usage Min (0) */
	0x29, 0xFF,       /*   Usage Max (255) */
	0x15, 0x00,       /*   Logical Min (0) */
	0x26, 0xFF, 0x00, /*   Logical Max (255) */
	0x75, 0x08,       /*   Report Size (8) */
	0x95, 0x06,       /*   Report Count (6) */
	0x81, 0x00,       /*   Input (Data, Array): 6 keycodes */
	0xC0,             /* End Collection */

	/* --- Mouse (relative), report ID 2 --- */
	0x05, 0x01,       /* Usage Page (Generic Desktop) */
	0x09, 0x02,       /* Usage (Mouse) */
	0xA1, 0x01,       /* Collection (Application) */
	0x85, REPORT_ID_MOUSE,
	0x09, 0x01,       /*   Usage (Pointer) */
	0xA1, 0x00,       /*   Collection (Physical) */
	0x05, 0x09,       /*     Usage Page (Buttons) */
	0x19, 0x01,       /*     Usage Min (1) */
	0x29, 0x03,       /*     Usage Max (3) */
	0x15, 0x00,       /*     Logical Min (0) */
	0x25, 0x01,       /*     Logical Max (1) */
	0x75, 0x01,       /*     Report Size (1) */
	0x95, 0x03,       /*     Report Count (3) */
	0x81, 0x02,       /*     Input (Data, Var, Abs): button bits */
	0x75, 0x05,       /*     Report Size (5) */
	0x95, 0x01,       /*     Report Count (1) */
	0x81, 0x01,       /*     Input (Const): padding */
	0x05, 0x01,       /*     Usage Page (Generic Desktop) */
	0x09, 0x30,       /*     Usage (X) */
	0x09, 0x31,       /*     Usage (Y) */
	0x09, 0x38,       /*     Usage (Wheel) */
	0x15, 0x81,       /*     Logical Min (-127) */
	0x25, 0x7F,       /*     Logical Max (127) */
	0x75, 0x08,       /*     Report Size (8) */
	0x95, 0x03,       /*     Report Count (3) */
	0x81, 0x06,       /*     Input (Data, Var, Rel): dx, dy, wheel */
	0xC0,             /*   End Collection */
	0xC0,             /* End Collection */
};

static const uint8_t report_map_abs[] = {
	/* --- Keyboard, report ID 1 --- */
	0x05, 0x01,
	0x09, 0x06,
	0xA1, 0x01,
	0x85, REPORT_ID_KEYBOARD,
	0x05, 0x07,
	0x19, 0xE0,
	0x29, 0xE7,
	0x15, 0x00,
	0x25, 0x01,
	0x75, 0x01,
	0x95, 0x08,
	0x81, 0x02,
	0x75, 0x08,
	0x95, 0x01,
	0x81, 0x01,
	0x05, 0x07,
	0x19, 0x00,
	0x29, 0xFF,
	0x15, 0x00,
	0x26, 0xFF, 0x00,
	0x75, 0x08,
	0x95, 0x06,
	0x81, 0x00,
	0xC0,

	/* --- Mouse (absolute), report ID 2 --- */
	0x05, 0x01,       /* Usage Page (Generic Desktop) */
	0x09, 0x02,       /* Usage (Mouse) */
	0xA1, 0x01,       /* Collection (Application) */
	0x85, REPORT_ID_MOUSE,
	0x09, 0x01,       /*   Usage (Pointer) */
	0xA1, 0x00,       /*   Collection (Physical) */
	0x05, 0x09,       /*     Usage Page (Buttons) */
	0x19, 0x01,       /*     Usage Min (1) */
	0x29, 0x03,       /*     Usage Max (3) */
	0x15, 0x00,       /*     Logical Min (0) */
	0x25, 0x01,       /*     Logical Max (1) */
	0x75, 0x01,       /*     Report Size (1) */
	0x95, 0x03,       /*     Report Count (3) */
	0x81, 0x02,       /*     Input (Data, Var, Abs): button bits */
	0x75, 0x05,       /*     Report Size (5) */
	0x95, 0x01,       /*     Report Count (1) */
	0x81, 0x01,       /*     Input (Const): padding */
	0x05, 0x01,       /*     Usage Page (Generic Desktop) */
	0x09, 0x30,       /*     Usage (X) */
	0x09, 0x31,       /*     Usage (Y) */
	0x15, 0x00,       /*     Logical Min (0) */
	0x26, 0xFF, 0x7F, /*     Logical Max (32767) */
	0x75, 0x10,       /*     Report Size (16) */
	0x95, 0x02,       /*     Report Count (2) */
	0x81, 0x02,       /*     Input (Data, Var, Abs): x, y (uint16 LE) */
	0x09, 0x38,       /*     Usage (Wheel) */
	0x15, 0x81,       /*     Logical Min (-127) */
	0x25, 0x7F,       /*     Logical Max (127) */
	0x75, 0x08,       /*     Report Size (8) */
	0x95, 0x01,       /*     Report Count (1) */
	0x81, 0x06,       /*     Input (Data, Var, Rel): wheel */
	0xC0,             /*   End Collection */
	0xC0,             /* End Collection */
};

/* HID service object.  Input report count = 2 (keyboard + one mouse). */
BT_HIDS_DEF(hids_obj, KEYBOARD_REPORT_LEN,
	    MOUSE_REL_REPORT_LEN > MOUSE_ABS_REPORT_LEN ?
	    MOUSE_REL_REPORT_LEN : MOUSE_ABS_REPORT_LEN);

static struct bt_conn *active_conn;
static bool hids_inited;
static bool mouse_abs_mode;

/* --- event handlers --------------------------------------------------- */

static void hids_pm_evt_handler(enum bt_hids_pm_evt evt, struct bt_conn *conn)
{
	switch (evt) {
	case BT_HIDS_PM_EVT_BOOT_MODE_ENTERED:
		LOG_INF("boot mode entered");
		break;
	case BT_HIDS_PM_EVT_REPORT_MODE_ENTERED:
		LOG_INF("report mode entered");
		break;
	default:
		break;
	}
}

static void hids_cp_evt_handler(enum bt_hids_cp_evt evt)
{
	switch (evt) {
	case BT_HIDS_CP_EVT_HOST_SUSP:
		LOG_INF("host suspended");
		break;
	case BT_HIDS_CP_EVT_HOST_EXIT_SUSP:
		LOG_INF("host resumed");
		break;
	default:
		break;
	}
}

/* --- public API ------------------------------------------------------- */

int anykvm_hids_init(bool abs_mode)
{
	struct bt_hids_init_param param = { 0 };

	if (hids_inited) {
		LOG_ERR("hids already initialised; call deinit first");
		return -EALREADY;
	}

	param.info.bcd_hid = 0x0111; /* HID 1.11 */
	param.info.b_country_code = 0x00;
	param.info.flags = BT_HIDS_REMOTE_WAKE | BT_HIDS_NORMALLY_CONNECTABLE;

	if (abs_mode) {
		param.rep_map.data = report_map_abs;
		param.rep_map.size = sizeof(report_map_abs);
		param.inp_rep_group_init.reports[INPUT_REP_IDX_MOUSE].size =
			MOUSE_ABS_REPORT_LEN;
	} else {
		param.rep_map.data = report_map_rel;
		param.rep_map.size = sizeof(report_map_rel);
		param.inp_rep_group_init.reports[INPUT_REP_IDX_MOUSE].size =
			MOUSE_REL_REPORT_LEN;
	}

	param.inp_rep_group_init.reports[INPUT_REP_IDX_KEYBOARD].size =
		KEYBOARD_REPORT_LEN;
	param.inp_rep_group_init.reports[INPUT_REP_IDX_KEYBOARD].id =
		REPORT_ID_KEYBOARD;
	param.inp_rep_group_init.reports[INPUT_REP_IDX_MOUSE].id =
		REPORT_ID_MOUSE;
	param.inp_rep_group_init.cnt = 2;

	param.pm_evt_handler = hids_pm_evt_handler;
	param.cp_evt_handler = hids_cp_evt_handler;

	int err = bt_hids_init(&hids_obj, &param);

	if (!err) {
		hids_inited = true;
		mouse_abs_mode = abs_mode;
	}
	return err;
}

/*
 * De-register the HID GATT service so the report map can be changed.
 *
 * Uses bt_hids_uninit() which is available in nRF Connect SDK v2.5+.
 * If your SDK version does not provide this function, replace the body
 * with bt_gatt_service_unregister() calls targeting the HID, BAS and DIS
 * services that bt_hids_init() registered.  See the HIDS module source
 * (subsys/bluetooth/services/hids.c) for the service pointer names.
 */
int anykvm_hids_deinit(void)
{
	if (!hids_inited) {
		return 0;
	}

	if (active_conn) {
		bt_hids_disconnected(&hids_obj, active_conn);
		active_conn = NULL;
	}

	bt_hids_uninit(&hids_obj);
	hids_inited = false;
	return 0;
}

void anykvm_hids_connected(struct bt_conn *conn)
{
	int err = bt_hids_connected(&hids_obj, conn);

	if (err) {
		LOG_ERR("hids connected: %d", err);
		return;
	}
	active_conn = conn;
}

void anykvm_hids_disconnected(struct bt_conn *conn)
{
	if (conn == active_conn) {
		active_conn = NULL;
	}
	bt_hids_disconnected(&hids_obj, conn);
}

int anykvm_hids_send_keyboard(const uint8_t report[8])
{
	if (active_conn == NULL) {
		return 0;
	}
	return bt_hids_inp_rep_send(&hids_obj, active_conn,
				    INPUT_REP_IDX_KEYBOARD, report,
				    KEYBOARD_REPORT_LEN, NULL);
}

int anykvm_hids_send_mouse(uint8_t buttons, int16_t dx_or_x,
			    int16_t dy_or_y, int8_t wheel)
{
	if (active_conn == NULL) {
		return 0;
	}

	if (mouse_abs_mode) {
		uint8_t report[MOUSE_ABS_REPORT_LEN] = {
			buttons,
			(uint8_t)((uint16_t)dx_or_x & 0xFF),
			(uint8_t)(((uint16_t)dx_or_x >> 8) & 0xFF),
			(uint8_t)((uint16_t)dy_or_y & 0xFF),
			(uint8_t)(((uint16_t)dy_or_y >> 8) & 0xFF),
			(uint8_t)(int8_t)wheel,
		};

		return bt_hids_inp_rep_send(&hids_obj, active_conn,
					    INPUT_REP_IDX_MOUSE, report,
					    MOUSE_ABS_REPORT_LEN, NULL);
	}

	/* relative mode */
	uint8_t report[MOUSE_REL_REPORT_LEN] = {
		buttons,
		(uint8_t)(int8_t)dx_or_x,
		(uint8_t)(int8_t)dy_or_y,
		(uint8_t)(int8_t)wheel,
	};

	return bt_hids_inp_rep_send(&hids_obj, active_conn,
				    INPUT_REP_IDX_MOUSE, report,
				    MOUSE_REL_REPORT_LEN, NULL);
}
```

## src/hids.h
```c
/*
 * AnyKVM nRF52840 firmware — BLE HID service.
 *
 * Supports two mouse report maps, selected by init_mode:
 *   - Relative mouse (4B: buttons, dx, dy, wheel) — for iOS and relative hosts
 *   - Absolute mouse (6B: buttons, x_le 2B, y_le 2B, wheel) — for macOS/Win/Linux
 *
 * Only ONE mouse report is exposed at a time (report ID 2 in both modes).
 * Use anykvm_hids_deinit() + anykvm_hids_init(new_mode) to switch.
 */
#ifndef ANYKVM_HIDS_H_
#define ANYKVM_HIDS_H_

#include <stdbool.h>
#include <stdint.h>

struct bt_conn;

int  anykvm_hids_init(bool abs_mode);

/*
 * De-register the HID GATT service, allowing re-initialisation with a
 * different report map.  Requires CONFIG_BT_GATT_DYNAMIC_DB=y.
 * After calling this, anykvm_hids_init() can be called again.
 */
int  anykvm_hids_deinit(void);

/* Notify a connection established/lost so HIDS can (de)register the client. */
void anykvm_hids_connected(struct bt_conn *conn);
void anykvm_hids_disconnected(struct bt_conn *conn);

/*
 * Send a mouse input report using the currently active report format.
 * For relative mode:  dx, dy are treated as int8 deltas.
 * For absolute mode: dx, dy are treated as uint16 absolute coordinates (0-32767).
 */
int  anykvm_hids_send_mouse(uint8_t buttons, int16_t dx_or_x,
			     int16_t dy_or_y, int8_t wheel);

int  anykvm_hids_send_keyboard(const uint8_t report[8]);

#endif /* ANYKVM_HIDS_H_ */
```

## src/led.c
```c
/*
 * AnyKVM nRF52840 firmware - LED status indicator.
 *
 * XIAO BLE: led0 = red, led1 = green, led2 = blue.
 * Blue  — BLE connection / advertising status (led_set).
 * Green — PC USB serial + BLE both connected (led_set_pc_host + led_set).
 * Red   — fault / init error (led_on / led_off); reserved for other uses later.
 */
#include <zephyr/kernel.h>
#include <zephyr/drivers/gpio.h>

#include "led.h"

#ifndef ANYKVM_BLE_LED_NODE
#define ANYKVM_BLE_LED_NODE DT_ALIAS(led2)
#endif

#ifndef ANYKVM_HOST_LED_NODE
#define ANYKVM_HOST_LED_NODE DT_ALIAS(led1)
#endif

#ifndef ANYKVM_FAULT_LED_NODE
#define ANYKVM_FAULT_LED_NODE DT_ALIAS(led0)
#endif

#if DT_NODE_EXISTS(ANYKVM_BLE_LED_NODE)
static const struct gpio_dt_spec ble_led =
	GPIO_DT_SPEC_GET(ANYKVM_BLE_LED_NODE, gpios);
#else
static const struct gpio_dt_spec ble_led;
#endif

#if DT_NODE_EXISTS(ANYKVM_HOST_LED_NODE)
static const struct gpio_dt_spec host_led =
	GPIO_DT_SPEC_GET(ANYKVM_HOST_LED_NODE, gpios);
#else
static const struct gpio_dt_spec host_led;
#endif

#if DT_NODE_EXISTS(ANYKVM_FAULT_LED_NODE)
static const struct gpio_dt_spec fault_led =
	GPIO_DT_SPEC_GET(ANYKVM_FAULT_LED_NODE, gpios);
#else
static const struct gpio_dt_spec fault_led;
#endif

static bool ble_led_has_hw;
static bool host_led_has_hw;
static bool fault_led_has_hw;

static bool pc_host_connected;
static bool ble_connected;

static void led_blink_work_fn(struct k_work *work);
static K_WORK_DELAYABLE_DEFINE(led_blink_work, led_blink_work_fn);
static uint32_t blink_period;
static bool blink_running;

static void led_update_ready(void)
{
	if (!host_led_has_hw) {
		return;
	}
	gpio_pin_set_dt(&host_led, pc_host_connected && ble_connected);
}

static void schedule_blink(uint32_t period_ms)
{
	blink_period = period_ms;
	blink_running = true;
	k_work_reschedule(&led_blink_work, K_MSEC(period_ms));
}

static void led_blink_work_fn(struct k_work *work)
{
	if (!blink_running || !ble_led_has_hw) {
		return;
	}
	gpio_pin_toggle_dt(&ble_led);
	k_work_reschedule(&led_blink_work, K_MSEC(blink_period));
}

void led_init(void)
{
#if DT_NODE_EXISTS(ANYKVM_BLE_LED_NODE)
	if (gpio_is_ready_dt(&ble_led)) {
		gpio_pin_configure_dt(&ble_led, GPIO_OUTPUT_INACTIVE);
		ble_led_has_hw = true;
	}
#endif
#if DT_NODE_EXISTS(ANYKVM_HOST_LED_NODE)
	if (gpio_is_ready_dt(&host_led)) {
		gpio_pin_configure_dt(&host_led, GPIO_OUTPUT_INACTIVE);
		host_led_has_hw = true;
	}
#endif
#if DT_NODE_EXISTS(ANYKVM_FAULT_LED_NODE)
	if (gpio_is_ready_dt(&fault_led)) {
		gpio_pin_configure_dt(&fault_led, GPIO_OUTPUT_INACTIVE);
		fault_led_has_hw = true;
	}
#endif
}

void led_set(bool connected, bool advertising, bool bonded)
{
	ble_connected = connected;
	led_update_ready();

	if (!ble_led_has_hw) {
		return;
	}
	blink_running = false;
	k_work_cancel_delayable(&led_blink_work);

	if (connected) {
		gpio_pin_set_dt(&ble_led, 1);
	} else if (advertising) {
		schedule_blink(bonded ? 200 : 500);
	} else {
		gpio_pin_set_dt(&ble_led, 0);
	}
}

void led_set_pc_host(bool connected)
{
	if (pc_host_connected == connected) {
		return;
	}
	pc_host_connected = connected;
	led_update_ready();
}

void led_on(void)
{
	if (!fault_led_has_hw) {
		return;
	}
	gpio_pin_set_dt(&fault_led, 1);
}

void led_off(void)
{
	if (!fault_led_has_hw) {
		return;
	}
	gpio_pin_set_dt(&fault_led, 0);
}
```

## src/led.h
```c
/*
 * AnyKVM nRF52840 firmware — LED status indicator.
 *
 * led_set       — blue LED (BLE advertising / connected on XIAO BLE).
 * led_set_pc_host — green LED (PC USB serial + BLE both connected).
 * led_on/off    — red LED (init fault blink; reserved for other alerts).
 */

#ifndef ANYKVM_LED_H_
#define ANYKVM_LED_H_

#include <stdbool.h>

void led_init(void);
void led_set(bool connected, bool advertising, bool bonded);
void led_set_pc_host(bool connected);
void led_on(void);
void led_off(void);

#endif /* ANYKVM_LED_H_ */
```

## src/profiles.c
```c
/*
 * AnyKVM nRF52840 firmware — multi-device profile manager.
 */
#include <zephyr/kernel.h>
#include <zephyr/logging/log.h>
#include <zephyr/settings/settings.h>
#include <zephyr/bluetooth/bluetooth.h>
#include <zephyr/bluetooth/conn.h>
#include <zephyr/bluetooth/hci.h>
#include <zephyr/bluetooth/uuid.h>

#include "profiles.h"
#include "hids.h"
#include "reply.h"
#include "led.h"

LOG_MODULE_REGISTER(anykvm_profiles, LOG_LEVEL_INF);

#define PROFILE_COUNT CONFIG_APP_PROFILE_COUNT

/* Maps profile slot -> Zephyr bt_id (BLE identity index). */
static uint8_t slot_id[PROFILE_COUNT];
static uint8_t active_slot;
static bool advertising;
static struct bt_conn *current_conn;

/* Per-slot mouse mode: 0 = relative, 1 = absolute. */
static uint8_t slot_mmode[PROFILE_COUNT];

/* Trace current HID mode so we can rebuild only when it actually changes. */
static bool current_hid_abs;

static const struct bt_data adv_ad[] = {
	BT_DATA_BYTES(BT_DATA_FLAGS, (BT_LE_AD_GENERAL | BT_LE_AD_NO_BREDR)),
	BT_DATA_BYTES(BT_DATA_UUID16_ALL,
		      BT_UUID_16_ENCODE(BT_UUID_HIDS_VAL),
		      BT_UUID_16_ENCODE(BT_UUID_BAS_VAL)),
	BT_DATA_BYTES(BT_DATA_GAP_APPEARANCE, 0xC1, 0x03), /* 961: keyboard */
	BT_DATA(BT_DATA_NAME_COMPLETE, CONFIG_BT_DEVICE_NAME,
		sizeof(CONFIG_BT_DEVICE_NAME) - 1),
};

/* --- settings persistence ---------------------------------------------- */

static int bkvm_set(const char *name, size_t len, settings_read_cb read_cb,
		    void *cb_arg)
{
	if (!settings_name_steq(name, "mmode", NULL)) {
		return -ENOENT;
	}

	if (len != PROFILE_COUNT) {
		return -EINVAL;
	}

	uint8_t buf[PROFILE_COUNT];

	if (read_cb(cb_arg, buf, len) != (ssize_t)len) {
		return -EINVAL;
	}
	memcpy(slot_mmode, buf, PROFILE_COUNT);
	return 0;
}

static int bkvm_commit(void)
{
	LOG_INF("settings committed");
	return 0;
}

SETTINGS_STATIC_HANDLER_DEFINE(bkvm_storage, "bkvm", NULL, bkvm_set,
			       bkvm_commit, NULL);

/* --- bond bookkeeping -------------------------------------------------- */

struct bond_scan {
	uint8_t id;
	bool found;
};

static void bond_scan_cb(const struct bt_bond_info *info, void *user_data)
{
	struct bond_scan *scan = user_data;

	(void)info;
	scan->found = true;
}

static bool slot_bonded(uint8_t slot)
{
	struct bond_scan scan = { .id = slot_id[slot], .found = false };

	bt_foreach_bond(slot_id[slot], bond_scan_cb, &scan);
	return scan.found;
}

/* --- advertising ------------------------------------------------------ */

static int adv_stop(void)
{
	if (!advertising) {
		return 0;
	}
	int err = bt_le_adv_stop();

	if (err && err != -EALREADY) {
		LOG_ERR("adv stop: %d", err);
		return err;
	}
	advertising = false;
	return 0;
}

static int adv_start_active(void)
{
	struct bt_le_adv_param param = *BT_LE_ADV_CONN;

	param.id = slot_id[active_slot];

	if (slot_bonded(active_slot)) {
		param.options |= BT_LE_ADV_OPT_FILTER_CONN |
				 BT_LE_ADV_OPT_FILTER_SCAN_REQ;
	}

	int err = bt_le_adv_start(&param, adv_ad, ARRAY_SIZE(adv_ad), NULL, 0);

	if (err == -EALREADY) {
		advertising = true;
		return 0;
	}
	if (err) {
		LOG_ERR("adv start (slot %u): %d", active_slot, err);
		return err;
	}
	advertising = true;
	led_set(false, true, slot_bonded(active_slot));
	LOG_INF("advertising slot %u (id %u, bonded=%d)", active_slot,
		slot_id[active_slot], slot_bonded(active_slot));
	return 0;
}

/*
 * Rebuild HID GATT service when the mouse mode changes.
 * The caller must have stopped advertising and disconnected first.
 */
static int hids_apply_mode(bool abs_mode)
{
	if (abs_mode == current_hid_abs) {
		return 0;
	}

	int err = anykvm_hids_deinit();

	if (err) {
		LOG_ERR("hids deinit: %d", err);
		return err;
	}

	err = anykvm_hids_init(abs_mode);
	if (err) {
		LOG_ERR("hids init abs=%d: %d", abs_mode, err);
		return err;
	}

	current_hid_abs = abs_mode;
	LOG_INF("HIDS rebuilt (mouse mode now %s)",
		abs_mode ? "absolute" : "relative");
	return 0;
}

/* --- connection callbacks --------------------------------------------- */

/* 7.5 ms interval (6 × 1.25 ms). Matches CONFIG_BT_PERIPHERAL_PREF_* in prj.conf. */
#define FAST_CONN_INTERVAL 6
#define FAST_CONN_TIMEOUT  400

static void request_fast_conn(struct bt_conn *conn)
{
	struct bt_le_conn_param param = {
		.interval_min = FAST_CONN_INTERVAL,
		.interval_max = FAST_CONN_INTERVAL,
		.latency = 0,
		.timeout = FAST_CONN_TIMEOUT,
	};

	int err = bt_conn_le_param_update(conn, &param);

	if (err && err != -EALREADY) {
		LOG_WRN("conn param update: %d", err);
	}
}

static void on_connected(struct bt_conn *conn, uint8_t err)
{
	if (err) {
		LOG_WRN("connect failed: %u", err);
		adv_start_active();
		return;
	}
	advertising = false;
	current_conn = bt_conn_ref(conn);

	/* iOS HID requires an encrypted bond; request L2 on connect. */
	int sec_err = bt_conn_set_security(conn, BT_SECURITY_L2);

	if (sec_err && sec_err != -EALREADY) {
		LOG_WRN("security request: %d", sec_err);
	}

	anykvm_hids_connected(conn);
	reply_send_event(REPLY_EVT_CONNECTED, active_slot);
	led_set(true, false, slot_bonded(active_slot));
	request_fast_conn(conn);
}

static void on_disconnected(struct bt_conn *conn, uint8_t reason)
{
	LOG_INF("disconnected (reason %u)", reason);
	anykvm_hids_disconnected(conn);
	if (current_conn) {
		bt_conn_unref(current_conn);
		current_conn = NULL;
	}
	reply_send_event(REPLY_EVT_DISCONNECTED, active_slot);
	adv_start_active();
}

static void on_security_changed(struct bt_conn *conn, bt_security_t level,
				enum bt_security_err err)
{
	if (err) {
		LOG_WRN("security failed (level %d, err %d)", level, err);
	} else {
		LOG_INF("security level %d", level);
		if (level >= BT_SECURITY_L2 && conn == current_conn) {
			request_fast_conn(conn);
		}
	}
}

BT_CONN_CB_DEFINE(conn_callbacks) = {
	.connected = on_connected,
	.disconnected = on_disconnected,
	.security_changed = on_security_changed,
};

/* --- SMP auth (headless dongle: auto-confirm if passkey pairing) ----- */

static void auth_passkey_display(struct bt_conn *conn, unsigned int passkey)
{
	char addr[BT_ADDR_LE_STR_LEN];

	bt_addr_le_to_str(bt_conn_get_dst(conn), addr, sizeof(addr));
	LOG_INF("pairing passkey %06u for %s", passkey, addr);
	bt_conn_auth_passkey_confirm(conn);
}

static void auth_cancel(struct bt_conn *conn)
{
	char addr[BT_ADDR_LE_STR_LEN];

	bt_addr_le_to_str(bt_conn_get_dst(conn), addr, sizeof(addr));
	LOG_WRN("pairing cancelled for %s", addr);
}

static struct bt_conn_auth_cb auth_cb = {
	.passkey_display = auth_passkey_display,
	.cancel = auth_cancel,
};

static void notify_status(void)
{
	struct profile_status st;

	anykvm_profiles_status(&st);
	reply_send_status(st.slot, st.connected, st.bonded, st.advertising,
			   st.abs_mouse);
	led_set(st.connected, st.advertising, st.bonded);
}

static void pairing_complete(struct bt_conn *conn, bool bonded)
{
	char addr[BT_ADDR_LE_STR_LEN];

	bt_addr_le_to_str(bt_conn_get_dst(conn), addr, sizeof(addr));
	LOG_INF("pairing complete %s bonded=%d", addr, bonded);
	if (bonded) {
		notify_status();
	}
}

static void pairing_failed(struct bt_conn *conn, enum bt_security_err reason)
{
	char addr[BT_ADDR_LE_STR_LEN];

	bt_addr_le_to_str(bt_conn_get_dst(conn), addr, sizeof(addr));
	LOG_WRN("pairing failed %s reason=%d", addr, reason);
}

static struct bt_conn_auth_info_cb auth_info_cb = {
	.pairing_complete = pairing_complete,
	.pairing_failed = pairing_failed,
};

/* --- public API ------------------------------------------------------- */

int anykvm_profiles_init(void)
{
	int err = bt_conn_auth_cb_register(&auth_cb);

	if (err) {
		LOG_ERR("auth cb register: %d", err);
		return err;
	}

	err = bt_conn_auth_info_cb_register(&auth_info_cb);
	if (err) {
		LOG_ERR("auth info cb register: %d", err);
		return err;
	}

	return 0;
}

int anykvm_profiles_start(bool abs_mode)
{
	int err;

	ARG_UNUSED(abs_mode);

	slot_id[0] = BT_ID_DEFAULT;
	for (uint8_t s = 1; s < PROFILE_COUNT; s++) {
		int id = bt_id_create(NULL, NULL);

		if (id < 0) {
			LOG_ERR("bt_id_create slot %u: %d", s, id);
			return id;
		}
		slot_id[s] = (uint8_t)id;
	}

	memset(slot_mmode, 0, sizeof(slot_mmode));

	if (IS_ENABLED(CONFIG_BT_SETTINGS)) {
		settings_load();
	}

	active_slot = 0;

	err = hids_apply_mode(slot_mmode[active_slot] != 0);
	if (err) {
		LOG_ERR("hids apply boot mode: %d", err);
		return err;
	}

	reply_send_ready(PROFILE_COUNT);
	LOG_INF("AnyKVM BLE HID ready (%d profiles)", PROFILE_COUNT);

	return adv_start_active();
}

int anykvm_profiles_select(uint8_t slot)
{
	if (slot >= PROFILE_COUNT) {
		return -EINVAL;
	}
	if (slot == active_slot && (current_conn || advertising)) {
		return 0;
	}

	adv_stop();
	if (current_conn) {
		bt_conn_disconnect(current_conn,
				   BT_HCI_ERR_REMOTE_USER_TERM_CONN);
		for (int i = 0; i < 50 && current_conn; i++) {
			k_msleep(10);
		}
	}

	if (current_conn) {
		return -EBUSY;
	}
	/* The disconnect callback may have restarted the previous identity. */
	adv_stop();
	active_slot = slot;
	LOG_INF("selected profile slot %u", slot);

	bool want_abs = slot_mmode[slot] != 0;

	if (want_abs != current_hid_abs) {
		int err = hids_apply_mode(want_abs);

		if (err) {
			LOG_ERR("hids apply mode: %d", err);
			return err;
		}
	}

	return adv_start_active();
}

int anykvm_profiles_clear(uint8_t slot)
{
	if (slot >= PROFILE_COUNT) {
		return -EINVAL;
	}
	if (slot == active_slot && current_conn) {
		adv_stop();
		bt_conn_disconnect(current_conn, BT_HCI_ERR_REMOTE_USER_TERM_CONN);
		for (int i = 0; i < 50 && current_conn; i++) {
			k_msleep(10);
		}
		if (current_conn) {
			return -EBUSY;
		}
	}

	int err = bt_unpair(slot_id[slot], BT_ADDR_LE_ANY);

	if (err) {
		LOG_ERR("unpair slot %u: %d", slot, err);
		return err;
	}
	LOG_INF("cleared bond for slot %u", slot);

	if (slot == active_slot) {
		adv_stop();
		return adv_start_active();
	}
	return 0;
}

int anykvm_profiles_advertise(void)
{
	return adv_start_active();
}

bool anykvm_profiles_mouse_mode(void)
{
	return current_hid_abs;
}

int anykvm_profiles_set_mouse_mode(bool abs_mode)
{
	if (abs_mode == current_hid_abs) {
		return 0;
	}

	slot_mmode[active_slot] = abs_mode ? 1 : 0;

	if (IS_ENABLED(CONFIG_BT_SETTINGS)) {
		settings_runtime_set("bkvm/mmode", slot_mmode, PROFILE_COUNT);
	}

	adv_stop();
	if (current_conn) {
		bt_conn_disconnect(current_conn,
				   BT_HCI_ERR_REMOTE_USER_TERM_CONN);
		for (int i = 0; i < 50 && current_conn; i++) {
			k_msleep(10);
		}
	}

	if (current_conn) {
		return -EBUSY;
	}
	adv_stop();
	int err = hids_apply_mode(abs_mode);

	if (err) {
		return err;
	}

	return adv_start_active();
}

void anykvm_profiles_status(struct profile_status *out)
{
	out->slot = active_slot;
	out->connected = current_conn != NULL;
	out->bonded = slot_bonded(active_slot);
	out->advertising = advertising;
	out->abs_mouse = current_hid_abs;
}
```

## src/profiles.h
```c
/*
 * AnyKVM nRF52840 firmware — multi-device profile manager.
 *
 * Each profile is an independent BLE identity (own address + own bond) and
 * has its own mouse mode (absolute / relative) persisted in Zephyr settings.
 * Switching profiles rebuilds the HID GATT service when the mouse mode
 * changes.
 *
 * Uses the binary reply frame protocol (reply.h) instead of printk for
 * host-bound status and event messages.
 */
#ifndef ANYKVM_PROFILES_H_
#define ANYKVM_PROFILES_H_

#include <stdbool.h>
#include <stdint.h>

struct profile_status {
	uint8_t slot;
	bool connected;
	bool bonded;
	bool advertising;
	bool abs_mouse;
};

int anykvm_profiles_init(void);
int anykvm_profiles_start(bool abs_mode);

int anykvm_profiles_select(uint8_t slot);
int anykvm_profiles_clear(uint8_t slot);
int anykvm_profiles_advertise(void);

void anykvm_profiles_status(struct profile_status *out);

/* Current active slot's mouse mode (true = absolute, false = relative). */
bool anykvm_profiles_mouse_mode(void);

/*
 * Set the mouse mode for the currently active slot, persist it in settings,
 * and rebuild the HID GATT service if the mode changed.
 */
int anykvm_profiles_set_mouse_mode(bool abs_mode);

#endif /* ANYKVM_PROFILES_H_ */
```

## src/proto.c
```c
/* AnyKVM v1 framing shared with all serial HID modules. */
#include "proto.h"
#include "../../AnyKVMProtocol/src/AnyKVMProtocol.h"
static bk_parser parser;
uint16_t proto_crc16(const uint8_t *data, size_t len) { return bk_crc16(data, len); }
void proto_reset(void) { parser.used = 0; }
void proto_rx_byte(uint8_t byte, proto_frame_handler_t handler) {
    uint8_t cmd, data[4];
    if (bk_parse(&parser, byte, &cmd, data)) handler(cmd, data);
}
```

## src/proto.h
```c
/*
 * AnyKVM nRF52840 firmware — protocol layer.
 *
 * AnyKVM v1 8-byte framed protocol:
 *   [0x33][cmd 1B][data 4B][CRC16 BE 2B] = 8 bytes
 * CRC16 MODBUS: poly=0xA001, init=0xFFFF, reflected.
 */
#ifndef ANYKVM_PROTO_H_
#define ANYKVM_PROTO_H_

#include <stddef.h>
#include <stdint.h>

uint16_t proto_crc16(const uint8_t *data, size_t len);

typedef void (*proto_frame_handler_t)(uint8_t cmd, const uint8_t data[4]);

void proto_reset(void);
void proto_rx_byte(uint8_t byte, proto_frame_handler_t handler);

#endif /* ANYKVM_PROTO_H_ */
```

## src/reply.c
```c
/*
 * AnyKVM nRF52840 firmware — binary reply frame transmitter.
 */
#include <zephyr/kernel.h>
#include <zephyr/device.h>
#include <zephyr/drivers/uart.h>

#include "reply.h"
#include "proto.h"

static const struct device *cdc_dev;
K_MUTEX_DEFINE(reply_lock);

void reply_set_device(const struct device *cdc)
{
	cdc_dev = cdc;
}

void reply_send(uint8_t cmd, const uint8_t data[4])
{
	uint8_t frame[8];

	frame[0] = 0x33;
	frame[1] = cmd;
	frame[2] = data[0];
	frame[3] = data[1];
	frame[4] = data[2];
	frame[5] = data[3];

	uint16_t crc = proto_crc16(frame, 6);

	frame[6] = (uint8_t)((crc >> 8) & 0xFF);
	frame[7] = (uint8_t)(crc & 0xFF);

	if (cdc_dev) {
		k_mutex_lock(&reply_lock, K_FOREVER);
		for (int i = 0; i < 8; i++) {
			uart_poll_out(cdc_dev, frame[i]);
		}
		k_mutex_unlock(&reply_lock);
	}
}

void reply_send_ready(uint8_t slot_count)
{
	uint8_t data[4] = { slot_count, 0, 0, 0 };

	reply_send(0x80, data);
}

void reply_send_status(uint8_t slot, bool conn, bool bonded, bool adv,
		       bool abs_mouse)
{
	uint8_t flags = slot & 0x03;

	if (conn) {
		flags |= 0x04;
	}
	if (bonded) {
		flags |= 0x08;
	}
	if (adv) {
		flags |= 0x10;
	}
	if (abs_mouse) {
		flags |= 0x20;
	}

	uint8_t data[4] = { flags, 0, 0, 0 };

	reply_send(0x81, data);
}

void reply_send_event(uint8_t event_type, uint8_t slot)
{
	uint8_t data[4] = { event_type, slot, 0, 0 };

	reply_send(0x82, data);
}
```

## src/reply.h
```c
/*
 * AnyKVM nRF52840 firmware — binary reply frames.
 *
 * Sends 8-byte AnyKVM v1 reply frames over CDC ACM UART.
 * Frame: [0x33][cmd 1B][data 4B][CRC16 BE 2B]
 *
 * Reply commands:
 *   0x80  ready       data: [slot_count][0][0][0]
 *   0x81  status      data: [slot|conn|bonded|adv|abs_mouse packed][0][0][0]
 *   0x82  event       data: [event_type][slot][0][0]
 *   0x83  capabilities and 0x84 command results use the shared device layer.
 */
#ifndef ANYKVM_REPLY_H_
#define ANYKVM_REPLY_H_

#include <stdint.h>
#include <stdbool.h>

struct device;

#define REPLY_EVT_CONNECTED    0x01
#define REPLY_EVT_DISCONNECTED 0x02

/* Status packed bits in data[0]:
 *   bits 0-1: slot (0-3)
 *   bit 2:   connected
 *   bit 3:   bonded
 *   bit 4:   advertising
 *   bit 5:   abs_mouse (0=rel, 1=abs)
 */

void reply_send(uint8_t cmd, const uint8_t data[4]);
void reply_set_device(const struct device *cdc);

void reply_send_ready(uint8_t slot_count);
void reply_send_status(uint8_t slot, bool conn, bool bonded, bool adv,
		       bool abs_mouse);
void reply_send_event(uint8_t event_type, uint8_t slot);

#endif /* ANYKVM_REPLY_H_ */
```
